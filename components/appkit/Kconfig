## components/appkit/Kconfig
```kconfig
menu "appkit"

config APPKIT_HOSTED
    bool "Apps built into the OS (dashboards on the OS web server)"
    default n
    help
        Set in the OS firmwares: internal apps add their dashboard to the OS
        web server under /<app>/ and the OS rings the alarms. External apps
        leave it off and run their own server.

endmenu
```

## components/core/Kconfig
```kconfig
menu "Watch OS"

    config WATCH_REMOTE_UI
        bool "Remote screen through the authenticated web API"
        default y
        select LV_USE_SNAPSHOT

    config WATCH_MONKEY_TEST
        bool "Monkey test (random swipes, apps, screen on/off)"
        default n
        help
            Stress test for development: after the boot a task plays with
            the UI forever (no taps, only safe apps) and logs a health report
            every minute. Never enable it in a release.

    config WATCH_DEV_CONSOLE
        bool "Development console (screenshots, open apps, readings over USB)"
        default n
        select LV_USE_SNAPSHOT
        help
            Commands typed on the console drive the UI and print readings, for
            testing from the PC (tools/devcon.py in the firmware repos). Anyone
            with a USB cable could use it: never enable it in a release.

    config WATCH_LV_BAND_LINES
        int "LVGL bands drawn in PSRAM (lines, 0 = off)"
        default 0
        range 0 480
        help
            LVGL walks every widget once per band it draws, so many short bands
            (BOARD_DRAW_BUFFER_LINES) make swipes slow. With a value here LVGL draws
            two bands this tall in PSRAM and a sender task copies them through the
            internal DMA buffers to the panel: same internal RAM, far fewer passes.
            Only for panels fed by DMA (SPI/QSPI); with a rotated screen the
            sender also rotates each piece.
            Pick about a quarter of the panel height, rounded to an even number.

endmenu
```

## components/services/Kconfig
```kconfig
menu "Watch OS services"

    config WATCH_ECOS_PAIRING
        bool "ECOS experimental pairing (ESP-NOW or LAN)"
        default y
        help
            Explicit three-minute pairing window, device to device over ESP-NOW
            (no router) or over the home Wi-Fi when an IP is given. No idle
            task or listener; pairwise credentials only, without HID access.
            Disable to omit the service, watch page and dashboard controls.

    config WATCH_VOICE_MEMOS
        bool "Experimental local voice memos"
        default n
        help
            Enable only while validating microphone capture, playback and alarm
            handover on supported hardware. Disabled in production by default.


    config WATCH_UPDATE_MANIFEST_URL
        string "Online update: default manifest URL"
        default ""
        help
            JSON manifest checked by Settings > Aggiornamento when the user did
            not set an address: {"version": "1.2.0", "url": "https://.../x.bin"}.
            Each firmware project sets its own in sdkconfig.defaults (the CI
            publishes it, see .github/workflows/release.yml).

endmenu
```

## lite/sdkconfig.defaults
```kconfig
CONFIG_BT_ENABLED=n
CONFIG_APPKIT_HOSTED=y
CONFIG_ESP_WIFI_IRAM_OPT=n
CONFIG_ESP_WIFI_RX_IRAM_OPT=n
CONFIG_ESP_WIFI_STATIC_RX_BUFFER_NUM=4
CONFIG_ESP_WIFI_DYNAMIC_RX_BUFFER_NUM=8
CONFIG_ESP_WIFI_RX_BA_WIN=6
CONFIG_ESP_WIFI_DYNAMIC_TX_BUFFER_NUM=8
CONFIG_HTTPD_MAX_REQ_HDR_LEN=1024
CONFIG_HTTPD_MAX_URI_LEN=512
CONFIG_FREERTOS_USE_TRACE_FACILITY=y
CONFIG_FREERTOS_GENERATE_RUN_TIME_STATS=n
CONFIG_ESP_DEFAULT_CPU_FREQ_MHZ_160=y
CONFIG_LOG_DEFAULT_LEVEL_INFO=y
```
